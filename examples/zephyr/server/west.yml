## examples/zephyr/server/west.yml
```yaml
manifest:
  remotes:
    - name: zephyrproject-rtos
      url-base: https://github.com/zephyrproject-rtos
  projects:
    - name: zephyr
      remote: zephyrproject-rtos
      repo-path: zephyr
      # Choose a Zephyr revision that you know contains adi_eval_adin1110ebz.
      # Common choices: a released tag (e.g. v3.5.0) or main.
      revision: v4.3.0
      import: true
```
